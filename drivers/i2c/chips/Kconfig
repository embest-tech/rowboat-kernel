## drivers/i2c/chips/Kconfig
```kconfig
#
# Miscellaneous I2C chip drivers configuration
#
# *** DEPRECATED! Do not add new entries! See Makefile ***
#

menu "Miscellaneous I2C Chip support"

config VGA_CH7026
        tristate "VGA CH7026 CHIP"
        depends on I2C
        help
         say yes to support VGA CH7026 CHIP.

config VGA_CH7033
        tristate "VGA CH7033 CHIP"
        depends on I2C
        help
         say yes to support VGA CH7033 CHIP.

config SENSORS_PCA963X
	tristate "Philips PCA963X 4-bit I2C-bus LED"
	depends on I2C && EXPERIMENTAL
	help
	 If you say yes here you get support for the Philips PCA963X
	 4-bit I2C-bus LED.

	 This driver can also be built as a module.  If so, the module
	 will be called pca963X.

endmenu
```
